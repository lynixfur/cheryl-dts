// SPDX-License-Identifier: GPL-2.0
/* Copyright (c) 2016, The Linux Foundation. All rights reserved. */

/dts-v1/;

#include "msm8998-razer-cheryl.dtsi"

/ {
	model = "Razer Phone (cheryl)";
	compatible = "razer,cheryl","qcom,msm8998";

	qcom,board-id = <8 0 1 0>;
};
